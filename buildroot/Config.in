## buildroot/Config.in
```kconfig
menu "氵系统 shuios"

source "$BR2_EXTERNAL_SHUIOS_PATH/package/shuios/Config.in"

endmenu
```

## buildroot/package/qt6waylandcompositor/Config.in
```kconfig
config BR2_PACKAGE_QT6WAYLANDCOMPOSITOR
	bool "qt6waylandcompositor"
	depends on BR2_PACKAGE_QT6BASE_GUI
	depends on BR2_PACKAGE_WAYLAND
	select BR2_PACKAGE_WAYLAND_PROTOCOLS
	help
	  Qt6 Wayland Compositor 模块。

	  Buildroot 官方没有这个包，本外部树自建。
	  它提供 QtWaylandCompositor 库和 QML 类型，
	  是 shuios 自建桌面合成器的基础。

	  https://doc.qt.io/qt-6/qtwaylandcompositor-index.html

comment "qt6waylandcompositor needs Qt6 GUI and Wayland"
	depends on !BR2_PACKAGE_QT6BASE_GUI || !BR2_PACKAGE_WAYLAND
```

## buildroot/package/shuios/Config.in
```kconfig
config BR2_PACKAGE_SHUIOS
	bool "shuios (氵系统桌面)"
	select BR2_PACKAGE_QT6BASE_GUI
	select BR2_PACKAGE_QT6DECLARATIVE
	select BR2_PACKAGE_QT6DECLARATIVE_QUICK
	help
	  氵系统 shuios —— 为 AI 重新设计的桌面环境。

	  通过 eglfs 直接接管 DRM/KMS：内核之上没有登录管理器、
	  没有桌面环境、没有中间合成器。开机即是氵系统。

	  依赖 Qt6 Base (Gui/Network/EGLFS) 与 Qt6 Declarative (QML/Quick)。
	  Wayland 合成器为可选项（见 BR2_PACKAGE_QT6WAYLAND_COMPOSITOR）。

	  https://github.com/wanshuang-gzs/shuios
```
