## br2-ext/Config.in
```kconfig
menu "shuios"
	source "$BR2_EXTERNAL_SHUIOS_PATH/package/shuios-runtime/Config.in"
	source "$BR2_EXTERNAL_SHUIOS_PATH/package/llama-cpp/Config.in"
	source "$BR2_EXTERNAL_SHUIOS_PATH/package/shui-store/Config.in"
	source "$BR2_EXTERNAL_SHUIOS_PATH/package/shui-files/Config.in"
	source "$BR2_EXTERNAL_SHUIOS_PATH/package/shui-settings/Config.in"
	source "$BR2_EXTERNAL_SHUIOS_PATH/package/shui-panel/Config.in"
	source "$BR2_EXTERNAL_SHUIOS_PATH/package/shui-lock/Config.in"
	source "$BR2_EXTERNAL_SHUIOS_PATH/package/shui-browser/Config.in"
	# 现成的桌面外壳组件（"抄答案"路线）
	source "$BR2_EXTERNAL_SHUIOS_PATH/package/gtk-layer-shell/Config.in"
	source "$BR2_EXTERNAL_SHUIOS_PATH/package/waybar/Config.in"
	# 合成器：swayfx（= sway + 圆角/阴影/模糊），以及它依赖的 scenefx
	source "$BR2_EXTERNAL_SHUIOS_PATH/package/scenefx/Config.in"
	source "$BR2_EXTERNAL_SHUIOS_PATH/package/swayfx/Config.in"
	# 中文输入法：fcitx5 + Rime
	source "$BR2_EXTERNAL_SHUIOS_PATH/package/extra-cmake-modules/Config.in"
	source "$BR2_EXTERNAL_SHUIOS_PATH/package/iso-codes/Config.in"
	source "$BR2_EXTERNAL_SHUIOS_PATH/package/marisa-trie/Config.in"
	source "$BR2_EXTERNAL_SHUIOS_PATH/package/opencc/Config.in"
	source "$BR2_EXTERNAL_SHUIOS_PATH/package/librime/Config.in"
	source "$BR2_EXTERNAL_SHUIOS_PATH/package/rime-data/Config.in"
	source "$BR2_EXTERNAL_SHUIOS_PATH/package/fcitx5/Config.in"
	source "$BR2_EXTERNAL_SHUIOS_PATH/package/fcitx5-gtk/Config.in"
	source "$BR2_EXTERNAL_SHUIOS_PATH/package/fcitx5-rime/Config.in"
endmenu
```

## br2-ext/package/extra-cmake-modules/Config.in
```kconfig
config BR2_PACKAGE_EXTRA_CMAKE_MODULES
	bool "extra-cmake-modules"
	help
	  KDE 的 CMake 模块集，fcitx5 系列包用它提供的
	  ecm_add_wayland_client_protocol 等模块。

	  只安装到 staging（share/ECM），不会进入目标镜像。
```

## br2-ext/package/fcitx5-gtk/Config.in
```kconfig
config BR2_PACKAGE_FCITX5_GTK
	bool "fcitx5-gtk (GTK3 immodule)"
	depends on BR2_PACKAGE_FCITX5
	depends on BR2_PACKAGE_LIBGTK3
	depends on BR2_PACKAGE_LIBGTK3_WAYLAND
	help
	  GTK3 输入法模块（im-fcitx5.so）。shui-browser、shui-store、
	  shui-panel 都是 GTK3；没有它这些程序里的中文输入要依赖
	  合成器的 text-input 转发，候选窗定位也更差。
```

## br2-ext/package/fcitx5-rime/Config.in
```kconfig
config BR2_PACKAGE_FCITX5_RIME
	bool "fcitx5-rime"
	depends on BR2_PACKAGE_FCITX5
	select BR2_PACKAGE_LIBRIME
	select BR2_PACKAGE_RIME_DATA
	help
	  fcitx5 的 Rime 输入法引擎。配合 rime-data（朙月拼音 /
	  简化字拼音）实现中文输入。
```

## br2-ext/package/fcitx5/Config.in
```kconfig
config BR2_PACKAGE_FCITX5
	bool "fcitx5"
	depends on BR2_INSTALL_LIBSTDCPP
	depends on BR2_TOOLCHAIN_HAS_THREADS
	depends on BR2_USE_WCHAR
	depends on BR2_INIT_SYSTEMD
	select BR2_PACKAGE_CAIRO
	select BR2_PACKAGE_EXPAT
	select BR2_PACKAGE_EXTRA_CMAKE_MODULES
	select BR2_PACKAGE_GDK_PIXBUF
	select BR2_PACKAGE_ISO_CODES
	select BR2_PACKAGE_JSON_FOR_MODERN_CPP
	select BR2_PACKAGE_LIBGLIB2
	select BR2_PACKAGE_LIBRSVG
	select BR2_PACKAGE_LIBXKBCOMMON
	select BR2_PACKAGE_PANGO
	select BR2_PACKAGE_UTIL_LINUX_LIBUUID
	select BR2_PACKAGE_WAYLAND
	select BR2_PACKAGE_WAYLAND_PROTOCOLS
	select BR2_PACKAGE_XKEYBOARD_CONFIG
	select BR2_PACKAGE_ZLIB
	help
	  输入法框架。shuios 只用 Wayland 前端 + classic 候选窗，
	  X11 支持已关闭（系统里没有 X 服务器）。

	  https://fcitx-im.org/

comment "fcitx5 needs a systemd init"
	depends on !BR2_INIT_SYSTEMD
```

## br2-ext/package/gtk-layer-shell/Config.in
```kconfig
config BR2_PACKAGE_GTK_LAYER_SHELL
	bool "gtk-layer-shell"
	depends on BR2_PACKAGE_LIBGTK3
	depends on BR2_PACKAGE_LIBGTK3_WAYLAND
	select BR2_PACKAGE_WAYLAND
	select BR2_PACKAGE_WAYLAND_PROTOCOLS
	help
	  让 GTK3 应用能创建 Wayland layer-shell 表面（面板、桌面图标层、
	  通知这类"桌面外壳"）。waybar 硬依赖它。

	  https://github.com/wmww/gtk-layer-shell

comment "gtk-layer-shell needs GTK3 with the Wayland backend"
	depends on !BR2_PACKAGE_LIBGTK3 || !BR2_PACKAGE_LIBGTK3_WAYLAND
```

## br2-ext/package/iso-codes/Config.in
```kconfig
config BR2_PACKAGE_ISO_CODES
	bool "iso-codes"
	help
	  ISO 国家 / 语言 / 货币代码数据。fcitx5 的键盘布局用它的
	  JSON 数据把布局名翻译成人类可读文字。

	  https://salsa.debian.org/iso-codes-team/iso-codes
```

## br2-ext/package/librime/Config.in
```kconfig
config BR2_PACKAGE_LIBRIME
	bool "librime"
	depends on BR2_INSTALL_LIBSTDCPP
	depends on BR2_TOOLCHAIN_HAS_THREADS
	select BR2_PACKAGE_BOOST
	select BR2_PACKAGE_BOOST_REGEX
	select BR2_PACKAGE_GFLAGS
	select BR2_PACKAGE_GLOG
	select BR2_PACKAGE_LEVELDB
	select BR2_PACKAGE_MARISA_TRIE
	select BR2_PACKAGE_OPENCC
	select BR2_PACKAGE_YAML_CPP
	help
	  Rime 输入法引擎（librime）。fcitx5-rime 把它作为输入法核心，
	  负责拼音到汉字的转换与词典编译。

	  https://github.com/rime/librime
```

## br2-ext/package/llama-cpp/Config.in
```kconfig
config BR2_PACKAGE_LLAMA_CPP
	bool "llama.cpp（本地推理引擎）"
	depends on BR2_INSTALL_LIBSTDCPP
	depends on BR2_TOOLCHAIN_HAS_THREADS
	depends on BR2_USE_MMU
	help
	  llama.cpp 是纯 C/C++ 的 LLM 推理引擎，不需要 Python、不需要
	  CUDA 也能在 CPU 上跑量化模型。shuios 用它作为内置推理后端：
	  shuiosd 通过 /v1/chat/completions（OpenAI 兼容）与它通信，
	  shui 的自然语言能力就来自这里。

	  本包只安装命令行与服务端：
	    llama-server   OpenAI 兼容的 HTTP 服务（默认 127.0.0.1:8080）
	    llama-cli      一次性命令行推理
	    llama-bench    性能基准

	  GPU 加速（CUDA/Vulkan）在 v0.1 里刻意不做：先把 CPU 路径跑通，
	  避免把镜像体积和构建复杂度一次性拉满。见 docs/04-路线图.md。

	  https://github.com/ggml-org/llama.cpp

comment "llama.cpp 需要 C++ 工具链与线程支持"
	depends on !BR2_INSTALL_LIBSTDCPP || !BR2_TOOLCHAIN_HAS_THREADS || !BR2_USE_MMU
```

## br2-ext/package/marisa-trie/Config.in
```kconfig
config BR2_PACKAGE_MARISA_TRIE
	bool "marisa-trie"
	depends on BR2_INSTALL_LIBSTDCPP
	help
	  MARISA 是 Rime / OpenCC 使用的静态字典树（trie）库。
	  没有它 librime 无法编译词典。

	  https://github.com/s-yata/marisa-trie
```

## br2-ext/package/opencc/Config.in
```kconfig
config BR2_PACKAGE_OPENCC
	bool "OpenCC"
	depends on BR2_INSTALL_LIBSTDCPP
	select BR2_PACKAGE_MARISA_TRIE
	help
	  Open Chinese Convert：简繁转换库。librime 的 simplifier
	  过滤器（拼音出简体字）依赖它，librime 强制要求 OpenCC。

	  https://github.com/BYVoid/OpenCC
```

## br2-ext/package/rime-data/Config.in
```kconfig
config BR2_PACKAGE_RIME_DATA
	bool "rime-data (朙月拼音 / 简化字拼音)"
	help
	  Rime 共享数据：default.yaml、symbols/punctuation、essay 词频、
	  朙月拼音（luna_pinyin）与简化字拼音（pinyin_simp）方案。

	  数据来自 rime-prelude / rime-essay / rime-luna-pinyin /
	  rime-pinyin-simp 的钉住提交，装到 /usr/share/rime-data。
```

## br2-ext/package/scenefx/Config.in
```kconfig
config BR2_PACKAGE_SCENEFX
	bool "scenefx（wlroots 圆角/阴影/模糊库）"
	depends on BR2_PACKAGE_WLROOTS
	help
	  swayfx 的特效后端：在 wlroots scene API 上替换渲染器，
	  提供圆角（corner radius）、窗口阴影（shadows）、背景模糊（blur）。

	  它不是给普通用户直接用的程序，装它只为让 swayfx 编得出来。

	  https://github.com/wlrfx/scenefx
```

## br2-ext/package/shui-browser/Config.in
```kconfig
config BR2_PACKAGE_SHUI_BROWSER
	bool "shui-browser（WebKitGTK 图形浏览器）"
	depends on BR2_PACKAGE_WEBKITGTK
	help
	  shuios 的图形浏览器：地址栏、前进/后退/刷新、多标签页、
	  下载到 /workspace/下载、本地起始页。

	  引擎是 WebKitGTK（WebKit2GTK 4.1），支持 JavaScript、CSS
	  和图片；需要先启用 BR2_PACKAGE_WEBKITGTK。

	  https://github.com/shuios/shuios
```

## br2-ext/package/shui-files/Config.in
```kconfig
config BR2_PACKAGE_SHUI_FILES
	bool "shui-files（氵 文件管理器）"
	depends on BR2_PACKAGE_LIBGTK3
	select BR2_PACKAGE_LIBGTK3_WAYLAND
	help
	  shuios 的图形文件管理器：列表浏览、打开、新建文件夹、
	  重命名、删除（递归），支持隐藏文件与路径栏。

	  新窗口默认打开 /workspace；可执行文件直接运行，
	  其余文件交给 shui-browser 显示。

	  https://github.com/shuios/shuios
```

## br2-ext/package/shui-lock/Config.in
```kconfig
config BR2_PACKAGE_SHUI_LOCK
	bool "shui-lock（锁屏 + 空闲自动锁定）"
	depends on BR2_PACKAGE_LIBGTK3
	select BR2_PACKAGE_LIBGTK3_WAYLAND
	select BR2_PACKAGE_LIBXCRYPT
	select BR2_PACKAGE_LIBXKBCOMMON
	select BR2_PACKAGE_WAYLAND
	help
	  shuios 锁屏：全屏 OVERLAY 图层（gtk-layer-shell）盖住任务栏和
	  所有窗口，密码校验读 /etc/shadow（镜像没有 PAM）。锁屏期间切到
	  sway 的 "shui-lock" binding mode，默认快捷键全部失效。

	  同时安装 shui-idle（evdev 空闲检测，超时自动锁屏）和 shui-key
	  （Wayland 虚拟键盘注入，供锁屏验收与智能体自动化使用）。

	  https://github.com/shuios/shuios
```

## br2-ext/package/shui-panel/Config.in
```kconfig
config BR2_PACKAGE_SHUI_PANEL
	bool "shui-panel（Windows 风格底部任务栏）"
	depends on BR2_PACKAGE_LIBGTK3
	select BR2_PACKAGE_LIBGTK3_WAYLAND
	help
	  shuios 的底部任务栏：左侧「氵」开始按钮与常用应用图标，
	  右侧内存状态与时钟。图标由 Cairo 现画，运行中的程序下面有主色短线。

	  它是个无边框浮动窗口，由 sway 的 for_window 规则钉在屏幕底部。

	  https://github.com/shuios/shuios
```

## br2-ext/package/shui-settings/Config.in
```kconfig
config BR2_PACKAGE_SHUI_SETTINGS
	bool "shui-settings（氵 设置中心）"
	depends on BR2_PACKAGE_LIBGTK3
	select BR2_PACKAGE_LIBGTK3_WAYLAND
	help
	  shuios 的图形设置中心 MVP：网络页（有线/无线状态、Wi-Fi 扫描、
	  密码连接、断开）与关于页（系统/内核/内存/运行时间）。

	  后端调用镜像自带的 nmcli（NetworkManager），连接配置以 0600
	  keyfile 写入数据分区的 system-connections。显示/声音/电源等
	  页面在后续 P0 迭代补齐。

	  https://github.com/shuios/shuios
```

## br2-ext/package/shui-store/Config.in
```kconfig
config BR2_PACKAGE_SHUI_STORE
	bool "shui-store（氵 软件商店）"
	depends on BR2_PACKAGE_LIBGTK3
	select BR2_PACKAGE_LIBGTK3_WAYLAND
	help
	  shuios 的图形软件商店：列出 /usr/share/shuios/pkgrepo 里的软件包，
	  点一下就调用 shui-pkg 安装/卸载。

	  图标由 Cairo 现画，不依赖图标主题或图片资源。

	  https://github.com/shuios/shuios
```

## br2-ext/package/shuios-runtime/Config.in
```kconfig
config BR2_PACKAGE_SHUIOS_RUNTIME
	bool "shuios 智能体运行时 (shuiosd + shui + shui-ctl)"
	depends on BR2_INIT_SYSTEMD
	depends on BR2_TOOLCHAIN_USES_GLIBC
	help
	  氵系统 的核心用户态组件：

	    shuiosd   智能体运行时守护进程（cgroup v2 资源隔离、生命周期、
	              日志、内置 MCP 工具、本地模型仓库索引）
	    shui      AI 原生 shell（自然语言 + 系统工具调用）
	    shui-ctl  面向脚本与自动化的控制 CLI

	  二进制不在镜像构建里编译，而是由 tools/build-rust.sh 在构建主机上
	  原生编译后放进 br2-ext/artifacts/，本包负责安装与打包。

	  这样做的原因：shuios 的目标架构 x86_64 与构建主机一致，原生编译比
	  在 Buildroot 里再拉一套 Rust 交叉工具链更快、更可复现。代价是交叉
	  到 aarch64 时需要改这条流水线（见 docs/04-路线图.md）。

	  glibc 兼容性说明：构建主机（如 Ubuntu 24.04，glibc 2.39）产出的二进制
	  可以运行在目标镜像（Buildroot 2025.02 自带更新的 glibc）上；
	  glibc 只保证向后兼容，反向不保证。

	  注意：构建前必须先执行 ./tools/build-rust.sh，
	  否则 shuios-runtime 会在安装阶段明确报错并中止。

comment "shuios-runtime 需要 systemd 作为 init"
	depends on !BR2_INIT_SYSTEMD

comment "shuios-runtime 需要 glibc 工具链"
	depends on BR2_INIT_SYSTEMD && !BR2_TOOLCHAIN_USES_GLIBC
```

## br2-ext/package/swayfx/Config.in
```kconfig
config BR2_PACKAGE_SWAYFX
	bool "swayfx（带圆角/阴影/模糊的 sway）"
	depends on !BR2_PACKAGE_SWAY
	depends on BR2_PACKAGE_SYSTEMD # sd-bus
	depends on !BR2_STATIC_LIBS # wlroots
	depends on BR2_TOOLCHAIN_HAS_THREADS # pango, wlroots
	depends on BR2_PACKAGE_HAS_LIBEGL
	depends on BR2_PACKAGE_HAS_LIBGLES
	depends on BR2_PACKAGE_HAS_UDEV
	depends on BR2_TOOLCHAIN_HAS_SYNC_4 # json-c, pango
	depends on BR2_USE_WCHAR # pango
	depends on BR2_USE_MMU # pango
	depends on BR2_INSTALL_LIBSTDCPP # pango
	select BR2_PACKAGE_WLROOTS
	select BR2_PACKAGE_SCENEFX
	select BR2_PACKAGE_JSON_C
	select BR2_PACKAGE_PCRE2
	select BR2_PACKAGE_CAIRO
	select BR2_PACKAGE_CAIRO_PNG
	select BR2_PACKAGE_PANGO
	select BR2_PACKAGE_XKEYBOARD_CONFIG # runtime
	help
	  swayfx = sway + scenefx。除了 sway 的全部功能（i3 键位、i3 IPC、
	  wlr-layer-shell），额外支持圆角、窗口阴影、背景模糊，
	  这是"像 macOS/Windows 一样好看"在 Wayland 上唯一现成的路。

	  二进制名仍叫 sway，与上游 sway 互斥（两者都装 /usr/bin/sway）。

	  https://github.com/wlrfx/swayfx

if BR2_PACKAGE_SWAYFX

config BR2_PACKAGE_SWAYFX_SWAYBAR
	bool "swaybar"
	select BR2_PACKAGE_DEJAVU
	help
	  备用任务栏。shuios 默认用自研 shui-panel，swaybar 只在
	  shui-panel 起不来时兜底，所以关掉也不影响桌面。

config BR2_PACKAGE_SWAYFX_SWAYBAR_TRAY
	bool "swaybar tray"
	depends on BR2_PACKAGE_SWAYFX_SWAYBAR
	help
	  系统托盘（需要 sd-bus，systemd 已选）

config BR2_PACKAGE_SWAYFX_SWAYNAG
	bool "swaynag"
	help
	  顶部警告条。sway-config 里的「$mod+Shift+E 退出桌面」
	  用的就是它；没有它那条键位会静默失败。

endif # BR2_PACKAGE_SWAYFX
```

## br2-ext/package/waybar/Config.in
```kconfig
config BR2_PACKAGE_WAYBAR
	bool "waybar（现成的 Wayland 任务栏）"
	depends on BR2_PACKAGE_GTK_LAYER_SHELL
	depends on BR2_TOOLCHAIN_BUILDROOT_CXX || BR2_TOOLCHAIN_EXTERNAL_CXX
	select BR2_PACKAGE_GTKMM3
	select BR2_PACKAGE_LIBSIGC
	select BR2_PACKAGE_JSONCPP
	select BR2_PACKAGE_FMT
	select BR2_PACKAGE_SPDLOG
	select BR2_PACKAGE_LIBNL
	help
	  成熟度很高的 Wayland 面板/任务栏（layer-shell + CSS 主题）：
	  工作区、窗口任务列表（wlr/taskbar）、时钟、托盘、自定义模块。

	  shuios 用它在"像 Windows"这条路上直接抄现成答案，
	  自研的 shui-panel 保留作为兜底。

	  https://github.com/Alexays/Waybar
```
